## drivers/nfc/oplus_nfc/Kconfig
```kconfig
config OPLUS_NFC
    tristate  "config oplus nfc chipset"
        help
        define this config to get chipset version from dts.
```

## drivers/power/Kconfig
```kconfig
source "drivers/power/avs/Kconfig"
source "drivers/power/reset/Kconfig"
source "drivers/power/supply/Kconfig"

#ifdef OPLUS_FEATURE_CHG_BASIC
config OPLUS_SM6115R_CHARGER
	bool "OPLUS SM6115 charger driver"
	default n
	help
	  Enables support for the oplus charging framework

config OPLUS_SHORT_C_BATT_CHECK
	bool "OPLUS_SHORT_C_BATT CHECK SUPPORT"
	default n
	help
	  Say Y to include support

config OPLUS_SMART_CHARGER_SUPPORT
	bool "OPLUS smart charger support"
	help
	  Say Y to include support

config OPLUS_SHORT_HW_CHECK
	bool "OPLUS_SHORT_HW CHECK SUPPORT"
	default n
	help
	  Say Y to include support

config OPLUS_CHIP_SOC_NODE
	bool "OPLUS chip soc node"
	help
	  Say Y to include support

config OPLUS_SHORT_IC_CHECK
	bool "OPLUS_SHORT_IC CHECK SUPPORT"
	default n
	help
	  Say Y to include support

config OPLUS_RTC_DET_SUPPORT
	bool "OPLUS RTC DET SUPPORT"
	default n
	help
	  Say Y to include support

config OPLUS_CHECK_CHARGERID_VOLT
	bool "OPLUS CHECK CHARGERID VOLT"
	default n
	help
	  Say Y to include support

config OPLUS_SHIP_MODE_SUPPORT
	bool "OPLUS_SHIP_MODE_SUPPORT"
	default n
	help
	  Say Y to include support

config OPLUS_SHORT_USERSPACE
	bool "OPLUS batt userspace"
	help
	  Say Y to include support
source "drivers/power/oplus/Kconfig"
#endif

#ifdef OPLUS_FEATURE_POWERINFO_STANDBY
#/* add for wakelock profiler */
source "drivers/power/oplus_util/Kconfig"
#endif /* OPLUS_FEATURE_POWERINFO_STANDBY */
```

## drivers/power/oplus_util/Kconfig
```kconfig
config OPLUS_POWER_UTIL
	bool "oplus power util debug feature"
	depends on PM_SLEEP
	default n
	help
	    Oppo power debug feature
```

## drivers/usb/typec/pd/Kconfig
```kconfig
#
# TypeC Port Controller Device Configuration
#

config TCPC_CLASS
	bool "TypeC Port Controller Device Class"
	depends on TYPEC
	help
	  Say Y to enable
	  Typec Port
	  Controller Device
	  Class

config USB_POWER_DELIVERY
	bool "Support USB power delivery Function"
	depends on TCPC_CLASS
	default n
	help
	  Say Y to enable
	  USB
	  Power Delivery
	  support

config TCPC_ET7303
	bool "Richtek ET7303 TypeC port Controller Driver"
	depends on TCPC_CLASS
	default n
	help
	  Say Y to enable
	  Richtek ET7303
	  TypeC port Controller
	  Driver

config USB_PD_VBUS_STABLE_TOUT
	int "PD VBUS Stable Timeout"
	depends on USB_POWER_DELIVERY
	range 0 1000                       # >= 0,  <= 1000
	default 125
	help
	  Setup a timeout value (ms)
	  for
	  VBUS change
	  stable

config PD_DBG_INFO
	bool "PD debug information"
	depends on TCPC_CLASS
	default y
	help
	  Say Y to enable PD debug
	  information
	  Say N to disable
```
